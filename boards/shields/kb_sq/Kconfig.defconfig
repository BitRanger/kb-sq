## boards/shields/kb_sq/Kconfig.defconfig
```kconfig
if SHIELD_KB_SQ_LEFT

config ZMK_KEYBOARD_NAME
    default "kb-sq"

config ZMK_SPLIT_ROLE_CENTRAL
    default y

endif # SHIELD_KB_SQ_LEFT

if SHIELD_KB_SQ_LEFT || SHIELD_KB_SQ_RIGHT

config ZMK_SPLIT
    default y

# 12KRO (Default is 6KRO)
# config ZMK_HID_REPORT_TYPE_HKRO
#     default y
# config ZMK_HID_KEYBOARD_REPORT_SIZE
#     default 12

# Full NKRO loses support for some BIOS/UEFI versions
config ZMK_HID_REPORT_TYPE_NKRO
    default y

endif # SHIELD_KB_SQ_LEFT || SHIELD_KB_SQ_RIGHT
```
